## config/west.yml
```yaml
manifest:
  remotes:
    - name: zmkfirmware
      url-base: https://github.com/zmkfirmware
    - name: demizo
      url-base: https://github.com/demizo
  projects:
    - name: zmk
      remote: demizo
      revision: mouse-pr
      import: app/west.yml
  self:
    path: config
```
